#include "analyzer.h"
#include "bsp.h" // Board Support Package
#include "pc_com.h"
#include "private_signal_ranges.h"
#include "qpc.h" // QP/C real-time embedded framework
#include "safe_strncpy.h"
#include <math.h>
#include <stdio.h>
#include <string.h>

Q_DEFINE_THIS_MODULE("analyzer")

/**************************************************************************************************\
* Private macros
\**************************************************************************************************/

#define ADC_DMA_BUFFER_MAX_SIZE 512
#define DAC_DMA_BUFFER_MAX_SIZE ADC_DOWNSAMPLING_RATE *ADC_DMA_BUFFER_MAX_SIZE

#define NUM_ADC_SWEEPS 3

#define OUTPUT_MID   2050 // amplitude of sinusoid generated by DAC
#define OUTPUT_AMP   1950 // DC offset of sinusoid generated by DAC
#define pi           3.141592
#define SINUSOID_AMP 1024 // resolution of sin/cos for fourier transform

#define NUM_PERIODS 10 // (minimum) number of sinusoid waveforms to generate on DAC

// With 8 bit ADC, maximum reading is 0 to 256, to sinusoid amplitude is 128
#define MINIMUM_VOLTAGE_ACROSS_LOAD_RESISTOR 128 / 3
#define MAXIMUM_VOLTAGE_ACROSS_LOAD_RESISTOR 128 * 2 / 3

#define max(a, b)           \
    ({                      \
        typeof(a) _a = (a); \
        typeof(b) _b = (b); \
        _a > _b ? _a : _b;  \
    })

/**************************************************************************************************\
* Private type definitions
\**************************************************************************************************/

enum AnalyzerSignals
{
    SET_FREQ_RANGE_SIG = PRIVATE_SIGNAL_ANALYZER_START,
    BEGIN_FREQ_SWEEP_SIG,
    SINUSOID_COMPLETE_SIG,
    OFFSET_CALIBRATION_SIG,
    GAIN_CALIBRATION_SIG,
    SUBSTATE_FREQ_SWEEP_COMPLETE_SIG,
    TIMEOUT_SIG
};

typedef struct
{
    float real;
    float imag;
} Complex_T;

typedef struct
{
    QActive super; // inherit QActive

    // submachine state memory
    QStateHandler substate_super_state;

    QTimeEvt timeEvt; // private time event generator

    uint32_t freq_start;
    uint32_t freq_end;
    float32_t freq_spacing; // logarithmic spacing between frequencies
    uint16_t num_freq_points;
    uint16_t this_interval_index;

    Source_Impedance_T source_impedance;

    volatile uint8_t adc_callback_counter;
    bool running_sinusoid;

    uint16_t dac_dma_buffer[DAC_DMA_BUFFER_MAX_SIZE];
    int16_t sine_buffer[ADC_DMA_BUFFER_MAX_SIZE];
    int16_t cosine_buffer[ADC_DMA_BUFFER_MAX_SIZE];
    uint32_t adc_dma_buffer[ADC_DMA_BUFFER_MAX_SIZE];

    uint16_t dac_dma_data_len;
    uint16_t adc_dma_data_len;

    Complex_T current_offset_cal[FREQ_POINTS_MAX];
    Complex_T current_gain_cal[FREQ_POINTS_MAX];
} Analyzer;

typedef struct
{
    QEvt super;

    uint32_t freq_start;
    uint32_t freq_end;
    uint32_t num_freq_points;
} SetFreqRangeEvent_T;

/**************************************************************************************************\
* Private memory declarations
\**************************************************************************************************/

float32_t impedances[8] = {100, 330, 1000, 3300, 10000, 33000, 100000, 330000};

extern Analyzer Analyzer_inst;
Analyzer Analyzer_inst;
QActive *const AO_Analyzer = &Analyzer_inst.super;

/**************************************************************************************************\
* Private prototypes
\**************************************************************************************************/

static QState initial(Analyzer *const me, void const *const par);
static QState top(Analyzer *const me, QEvt const *const e);
static QState standby(Analyzer *const me, QEvt const *const e);
static QState running(Analyzer *const me, QEvt const *const e);
static QState eis(Analyzer *const me, QEvt const *const e);
static QState offset_calibration(Analyzer *const me, QEvt const *const e);
static QState gain_calibration(Analyzer *const me, QEvt const *const e);

static float StartNextSinusoid();
static float32_t PeriodToFrequency(float32_t period);
static void GenerateSinusoid(float32_t frequency);
static void FourierAnalysis(
    uint32_t *data,
    uint16_t data_len,
    Complex_T *V_data,
    Complex_T *I_data,
    float *V_THD,
    float *I_THD);
static float magnitude(Complex_T x);
static float mag_squared(Complex_T x);
static float phase(Complex_T x);
static Complex_T add(Complex_T x, Complex_T y);
static Complex_T subtract(Complex_T x, Complex_T y);
static Complex_T multiply(Complex_T x, Complex_T y);
static Complex_T divide(Complex_T x, Complex_T y);
static void ResetCalibration();

/**************************************************************************************************\
* Public functions
\**************************************************************************************************/

void Analyzer_ctor(void)
{
    Analyzer *const me = &Analyzer_inst;
    QActive_ctor(&me->super, Q_STATE_CAST(&initial));
    QTimeEvt_ctorX(&me->timeEvt, &me->super, TIMEOUT_SIG, 0U);

    memset(me->adc_dma_buffer, 0, ADC_DMA_BUFFER_MAX_SIZE * sizeof(me->adc_dma_buffer[0]));
    ResetCalibration();

    me->freq_start      = 4700;
    me->freq_end        = 400000;
    me->num_freq_points = 100;
    me->freq_spacing    = pow(
        (float) me->freq_end / (float) me->freq_start, 1.0 / me->num_freq_points);

    me->source_impedance = IMPEDANCE_10k;
    BSP_Set_Source_Impedance(me->source_impedance);

    // BSP_Set_DAC(OUTPUT_MID);
}

void Analyzer_Set_Freq_Range(uint32_t freq_start, uint32_t freq_end, uint32_t num_freq_points)
{
    Analyzer *const me = &Analyzer_inst;

    SetFreqRangeEvent_T *event = Q_NEW(SetFreqRangeEvent_T, SET_FREQ_RANGE_SIG);

    event->freq_start      = freq_start;
    event->freq_end        = freq_end;
    event->num_freq_points = num_freq_points;

    QACTIVE_POST(&me->super, (QEvt *) (event), &me->super);
}

void Analyzer_Begin_Impedance_Sweep()
{
    Analyzer *const me      = &Analyzer_inst;
    static QEvt const event = QEVT_INITIALIZER(BEGIN_FREQ_SWEEP_SIG);
    QACTIVE_POST(&(me->super), &event, NULL);
}

void Analyzer_Begin_Offset_Calibration()
{
    Analyzer *const me      = &Analyzer_inst;
    static QEvt const event = QEVT_INITIALIZER(OFFSET_CALIBRATION_SIG);
    QACTIVE_POST(&(me->super), &event, NULL);
}

void Analyzer_Begin_Gain_Calibration()
{
    Analyzer *const me      = &Analyzer_inst;
    static QEvt const event = QEVT_INITIALIZER(GAIN_CALIBRATION_SIG);
    QACTIVE_POST(&(me->super), &event, NULL);
}

void Analyzer_ADC_Callback(uint32_t dual_adc_val)
{
    Analyzer *const me = &Analyzer_inst;
    // if we're generating sinusoids
    if (me->running_sinusoid)
    {
        me->adc_callback_counter++;
        // post to myself when we've completed the required number of periods
        if (me->adc_callback_counter == NUM_ADC_SWEEPS)
        {
            static QEvt const event = QEVT_INITIALIZER(SINUSOID_COMPLETE_SIG);
            QACTIVE_POST(&me->super, &event, me);
        }
    }
}

/**************************************************************************************************\
* Private functions
\**************************************************************************************************/

// HSM definition ----------------------------------------------------------
QState initial(Analyzer *const me, void const *const par)
{
    Q_UNUSED_PAR(par);

    QTimeEvt_armX(&me->timeEvt, BSP_TICKS_PER_SEC / 2U, BSP_TICKS_PER_SEC / 2U);

    PC_COM_clear_plots();

    // Initialize the DAC to the 'mid' level
    // me->dac_dma_buffer[0] = OUTPUT_MID;
    // BSP_Setup_ADC_DAC_DMA(
    //     me->adc1_dma_buffer, me->adc2_dma_buffer, me->adc_dma_data_len, me->dac_dma_buffer, 1,
    //     2);
    // BSP_Start_Waveform_Timer(10);

    return Q_TRAN(&top);
}
//............................................................................
QState top(Analyzer *const me, QEvt const *const e)
{
    QState status;
    switch (e->sig)
    {
        case Q_INIT_SIG: {
            status = Q_TRAN(&standby);
            break;
        }
        case Q_ENTRY_SIG: {
            status = Q_HANDLED();
            break;
        }
        case POSTED_SET_SOURCE_IMPEDANCE_SIG: {
            me->source_impedance = Q_EVT_CAST(SetSourceImpedanceEvent_T)->impedance;

            status = Q_HANDLED();
            break;
        }
        case POSTED_WAVEFORM_CAPTURE_COMPLETE_SIG: {
            status = Q_HANDLED();
            break;
        }
        default: {
            status = Q_SUPER(&QHsm_top);
            break;
        }
    }
    return status;
}
//............................................................................
QState standby(Analyzer *const me, QEvt const *const e)
{
    QState status;
    switch (e->sig)
    {
        case Q_ENTRY_SIG: {
            status = Q_HANDLED();
            break;
        }
        case SET_FREQ_RANGE_SIG: {
            const SetFreqRangeEvent_T *event = Q_EVT_CAST(SetFreqRangeEvent_T);
            Q_ASSERT(event->freq_start < event->freq_end);
            Q_ASSERT(event->freq_start >= FREQ_MIN);
            Q_ASSERT(event->freq_end <= FREQ_MAX);

            me->freq_start      = event->freq_start;
            me->freq_end        = event->freq_end;
            me->num_freq_points = event->num_freq_points;
            me->freq_spacing    = pow(
                (float) me->freq_end / (float) me->freq_start, 1.0 / me->num_freq_points);

            // wipe the calibration
            ResetCalibration();

            status = Q_HANDLED();
            break;
        }
        // case TIMEOUT_SIG:
        case BEGIN_FREQ_SWEEP_SIG: {
            status = Q_TRAN(&eis);
            break;
        }
        case OFFSET_CALIBRATION_SIG: {
            status = Q_TRAN(&offset_calibration);
            break;
        }
        case GAIN_CALIBRATION_SIG: {
            status = Q_TRAN(&gain_calibration);
            break;
        }
        case POSTED_DRAW_SINUSOID_SIG: {
            GenerateSinusoid(Q_EVT_CAST(FloatEvent_T)->value);

            static float32_t dataY[DAC_DMA_BUFFER_MAX_SIZE];
            static uint32_t dataX[DAC_DMA_BUFFER_MAX_SIZE];
            for (int i = 0; i < me->dac_dma_data_len; i++)
            {
                dataX[i] = i;
                dataY[i] = (float32_t) me->dac_dma_buffer[i];
            }

            PC_COM_draw_plot(2, "sine", dataX, dataY, me->dac_dma_data_len);

            status = Q_HANDLED();
            break;
        }
        default: {
            status = Q_SUPER(&top);
            break;
        }
    }
    return status;
}
//............................................................................
QState running(Analyzer *const me, QEvt const *const e)
{
    QState status;
    switch (e->sig)
    {
        case Q_ENTRY_SIG: {
            status = Q_HANDLED();
            break;
        }
        default: {
            status = Q_SUPER(&top);
            break;
        }
    }
    return status;
}
//............................................................................
QState eis(Analyzer *const me, QEvt const *const e)
{
    QState status;
    static float thisFreq;
    switch (e->sig)
    {
        case Q_ENTRY_SIG: {
            me->running_sinusoid = true;

            PC_COM_clear_plots(); // wipe all plots in Python
            PC_COM_config_plot(0, "Impedance magnitude", "Frequency", "Hz", "Magnitude", "Ohm");
            PC_COM_config_plot(1, "Impedance phase", "Frequency", "Hz", "Phase", "°");
            PC_COM_config_plot(2, "Total harmonic distortion", "Frequency", "Hz", "THD", "");

            me->this_interval_index = 0;

            thisFreq = StartNextSinusoid();

            status = Q_HANDLED();
            break;
        }
        case SINUSOID_COMPLETE_SIG: {
            Complex_T V_data;
            Complex_T I_data;
            float V_THD;
            float I_THD;
            FourierAnalysis(
                me->adc_dma_buffer, me->adc_dma_data_len, &V_data, &I_data, &V_THD, &I_THD);

            Complex_T current_offset = me->current_offset_cal[me->this_interval_index];
            Complex_T current_gain   = me->current_gain_cal[me->this_interval_index];

            I_data = multiply(subtract(I_data, current_offset), current_gain);

            Complex_T Z = divide(V_data, I_data);

            PC_COM_add_datapoint_to_bode_plot(0, "Z", thisFreq, magnitude(Z), phase(Z));
            PC_COM_add_datapoint_to_plot(2, "V THD", thisFreq, V_THD);
            PC_COM_add_datapoint_to_plot(2, "I THD", thisFreq, I_THD);

            me->this_interval_index++;
            if (me->this_interval_index == me->num_freq_points)
                status = Q_TRAN(&standby);
            else
            {
                thisFreq = StartNextSinusoid();
                status   = Q_HANDLED();
            }
            break;
        }
        default: {
            status = Q_SUPER(&running);
            break;
        }
    }
    return status;
}
//............................................................................
QState offset_calibration(Analyzer *const me, QEvt const *const e)
{
    QState status;
    static float thisFreq;
    switch (e->sig)
    {
        case Q_ENTRY_SIG: {
            PC_COM_print("Beginning offset calibration");
            me->running_sinusoid    = true;
            me->this_interval_index = 0;

            thisFreq = StartNextSinusoid();

            status = Q_HANDLED();
            break;
        }
        case Q_EXIT_SIG: {
            PC_COM_print("Finished offset calibration");
            status = Q_HANDLED();
            break;
        }
        case SINUSOID_COMPLETE_SIG: {
            Complex_T V_data;
            Complex_T I_data;
            float V_THD;
            float I_THD;
            FourierAnalysis(
                me->adc_dma_buffer, me->adc_dma_data_len, &V_data, &I_data, &V_THD, &I_THD);

            me->current_offset_cal[me->this_interval_index] = I_data;

            me->this_interval_index++;
            if (me->this_interval_index == me->num_freq_points)
                status = Q_TRAN(&standby);
            else
            {
                thisFreq = StartNextSinusoid();
                status   = Q_HANDLED();
            }
            break;
        }
        case TIMEOUT_SIG: {
            char print_buffer[PC_COM_EVENT_MAX_MSG_LENGTH] = {0};
            snprintf(
                print_buffer,
                sizeof(print_buffer),
                "Working... %d/%d",
                me->this_interval_index,
                me->num_freq_points);
            PC_COM_print(print_buffer);
            status = Q_HANDLED();
            break;
        }
        default: {
            status = Q_SUPER(&running);
            break;
        }
    }
    return status;
}
//............................................................................
QState gain_calibration(Analyzer *const me, QEvt const *const e)
{
    QState status;
    static float thisFreq;
    switch (e->sig)
    {
        case Q_ENTRY_SIG: {
            PC_COM_print("Beginning gain calibration");
            me->running_sinusoid    = true;
            me->this_interval_index = 0;

            thisFreq = StartNextSinusoid();

            status = Q_HANDLED();
            break;
        }
        case Q_EXIT_SIG: {
            PC_COM_print("Finished gain calibration");
            status = Q_HANDLED();
            break;
        }
        case SINUSOID_COMPLETE_SIG: {
            Complex_T V_data;
            Complex_T I_data;
            float V_THD;
            float I_THD;
            FourierAnalysis(
                me->adc_dma_buffer, me->adc_dma_data_len, &V_data, &I_data, &V_THD, &I_THD);

            Complex_T current_offset = me->current_offset_cal[me->this_interval_index];

            I_data = subtract(I_data, current_offset);

            Complex_T Z     = divide(V_data, I_data);
            Complex_T Z_cal = {10000.0, 0};

            me->current_gain_cal[me->this_interval_index] = divide(Z, Z_cal);

            me->this_interval_index++;
            if (me->this_interval_index == me->num_freq_points)
                status = Q_TRAN(&standby);
            else
            {
                thisFreq = StartNextSinusoid();
                status   = Q_HANDLED();
            }
            break;
        }
        case TIMEOUT_SIG: {
            char print_buffer[PC_COM_EVENT_MAX_MSG_LENGTH] = {0};
            snprintf(
                print_buffer,
                sizeof(print_buffer),
                "Working... %d/%d",
                me->this_interval_index,
                me->num_freq_points);
            PC_COM_print(print_buffer);
            status = Q_HANDLED();
            break;
        }
        default: {
            status = Q_SUPER(&running);
            break;
        }
    }
    return status;
}

/**
 ***************************************************************************************************
 *
 * @brief   Helper function to calculate next sinusoid frequency and setup the peripherals
 *
 **************************************************************************************************/

static float StartNextSinusoid()
{
    Analyzer *const me = &Analyzer_inst;
    BSP_Stop_ADC_DAC_DMA();

    float thisFreq;

    if (me->num_freq_points == 1)
        thisFreq = me->freq_start;
    else
    {
        float exponent = (float) me->this_interval_index / (float) (me->num_freq_points - 1);
        thisFreq       = me->freq_start * pow(me->freq_end / me->freq_start, exponent);
    }

    // generate the sinusoids in the DAC buffer and update the timer rate if
    // needed
    GenerateSinusoid(thisFreq);

    // calculate number of clock pulses to feed to the DAC
    // (ADC will receive 1/ADC_DOWNSAMPLING_RATE times as many)
    uint32_t dac_total_clock_periods = NUM_ADC_SWEEPS * me->adc_dma_data_len *
        ADC_DOWNSAMPLING_RATE;
    dac_total_clock_periods++;

    BSP_Setup_ADC_DAC_DMA(
        me->adc_dma_buffer,
        me->adc_dma_data_len,
        me->dac_dma_buffer,
        me->dac_dma_data_len,
        dac_total_clock_periods);

    me->adc_callback_counter = 0;

    BSP_Start_Waveform_Timer();
    return thisFreq;
}

/**
 ***************************************************************************************************
 *
 * @brief   Convert frequency [Hz] to number of timer periods at the ADC's clock frequency
 *
 **************************************************************************************************/

static float32_t PeriodToFrequency(float32_t period)
{
    return 12000000.0 / period / ADC_DOWNSAMPLING_RATE;
}

/**
 ***************************************************************************************************
 *
 * @brief   Generate sinusoids in RAM of the appropriate frequency
 *
 **************************************************************************************************/
static void GenerateSinusoid(float32_t frequency)
{
    Analyzer *const me = &Analyzer_inst;

    float32_t waveform_period_ideal = PeriodToFrequency(frequency);
    Q_ASSERT(waveform_period_ideal > 0);
    Q_ASSERT(waveform_period_ideal <= ADC_DMA_BUFFER_MAX_SIZE);

    // Calculate how many whole periods can fit in our buffer
    uint8_t num_periods = ADC_DMA_BUFFER_MAX_SIZE / waveform_period_ideal;

    me->adc_dma_data_len      = (uint16_t) (waveform_period_ideal * num_periods);
    float32_t waveform_period = (float32_t) (me->adc_dma_data_len) / num_periods;
    Q_ASSERT(me->adc_dma_data_len <= ADC_DMA_BUFFER_MAX_SIZE);
    me->dac_dma_data_len = me->adc_dma_data_len * ADC_DOWNSAMPLING_RATE;
    Q_ASSERT(me->dac_dma_data_len <= DAC_DMA_BUFFER_MAX_SIZE);

    for (uint16_t i = 0; i < me->dac_dma_data_len; i++)
    {
        double this_sin       = sin(2 * pi * i / waveform_period / ADC_DOWNSAMPLING_RATE);
        me->dac_dma_buffer[i] = OUTPUT_MID + this_sin * OUTPUT_AMP;

        if (i % ADC_DOWNSAMPLING_RATE == 0)
        {
            double this_cos = cos(2 * pi * i / waveform_period / ADC_DOWNSAMPLING_RATE);
            me->sine_buffer[i / ADC_DOWNSAMPLING_RATE]   = this_sin * SINUSOID_AMP;
            me->cosine_buffer[i / ADC_DOWNSAMPLING_RATE] = this_cos * SINUSOID_AMP;
        }
    }
    // ensure that the final datapoint is exactly in the midpoint
    // me->dac_dma_buffer[0]                        = OUTPUT_MID;
    me->dac_dma_buffer[me->dac_dma_data_len - 1] = OUTPUT_MID;
    // me->dac_dma_buffer[me->dac_dma_data_len - 3] = OUTPUT_MID;
    // me->dac_dma_buffer[me->dac_dma_data_len - 2] = OUTPUT_MID;
    // me->dac_dma_buffer[1]                        = OUTPUT_MID;
}

/**
 ***************************************************************************************************
 *
 * @brief   Find the amplitude and phase at a specific frequency from the ADC DMA buffer
 * Equivalent to evaluating the Fourier transform at a single frequency
 *
 **************************************************************************************************/

static void FourierAnalysis(
    uint32_t *data,
    uint16_t data_len,
    Complex_T *V_data,
    Complex_T *I_data,
    float *V_THD,
    float *I_THD)
{
    Analyzer *const me = &Analyzer_inst;

    uint32_t V_sum = 0;
    int32_t I_sum  = 0;
    for (int i = 0; i < data_len; i++)
    {
        int16_t v1 = me->adc_dma_buffer[i] & 0xFFF; // voltage at load
        int16_t v2 = me->adc_dma_buffer[i] >> 16;   // voltage at output of op amp
        V_sum += v1;
        I_sum += v2 - v1;
    }
    float V_mean = (float) V_sum / data_len;
    float I_mean = (float) I_sum / data_len;

    int32_t V_inPhase_sum      = 0;
    int32_t V_quadrature_sum   = 0;
    uint32_t V_mean_square_sum = 0; // the square of RMS
    int32_t I_inPhase_sum      = 0;
    int32_t I_quadrature_sum   = 0;
    uint32_t I_mean_square_sum = 0; // the square of RMS
    for (int i = 0; i < data_len; i++)
    {
        int16_t v1     = me->adc_dma_buffer[i] & 0xFFF; // voltage at load
        int16_t v2     = me->adc_dma_buffer[i] >> 16;   // voltage at output of op amp
        int16_t this_V = v1;
        int16_t this_I = v2 - v1;
        V_inPhase_sum += this_V * me->sine_buffer[i];
        V_quadrature_sum += this_V * me->cosine_buffer[i];
        V_mean_square_sum += (this_V - V_mean) * (this_V - V_mean);
        I_inPhase_sum += this_I * me->sine_buffer[i];
        I_quadrature_sum += this_I * me->cosine_buffer[i];
        I_mean_square_sum += (this_I - I_mean) * (this_I - I_mean);
    }
    V_data->real        = (float) V_inPhase_sum / SINUSOID_AMP / data_len * 2;
    V_data->imag        = (float) V_quadrature_sum / SINUSOID_AMP / data_len * 2;
    float V_mean_square = (float) V_mean_square_sum / data_len * 2;

    // at this point, I_data is the voltage across the source resistor
    I_data->real        = (float) I_inPhase_sum / SINUSOID_AMP / data_len * 2;
    I_data->imag        = (float) I_quadrature_sum / SINUSOID_AMP / data_len * 2;
    float I_mean_square = (float) I_mean_square_sum / data_len * 2;

    *V_THD = sqrt(V_mean_square - mag_squared(*V_data)) / magnitude(*V_data);
    *I_THD = sqrt(I_mean_square - mag_squared(*I_data)) / magnitude(*I_data);

    // convert voltage across resistor to current
    I_data->real /= impedances[me->source_impedance];
    I_data->imag /= impedances[me->source_impedance];
}

static float magnitude(Complex_T x)
{
    return sqrt(mag_squared(x));
}

static float mag_squared(Complex_T x)
{
    return pow(x.real, 2) + pow(x.imag, 2);
}

static float phase(Complex_T x)
{
    float phase = atan2(x.imag, x.real) * 180.0 / M_PI;
    if (phase > 180)
        phase -= 360;
    if (phase < -180)
        phase += 360;
    return phase;
}

static Complex_T add(Complex_T x, Complex_T y)
{
    Complex_T sum;
    sum.real = x.real + y.real;
    sum.imag = x.imag + y.imag;
    return sum;
}

static Complex_T subtract(Complex_T x, Complex_T y)
{
    Complex_T diff;
    diff.real = x.real - y.real;
    diff.imag = x.imag - y.imag;
    return diff;
}

static Complex_T multiply(Complex_T x, Complex_T y)
{
    Complex_T product;
    product.real = x.real * y.real - x.imag * y.imag;
    product.imag = x.real * y.imag + x.imag * y.real;
    return product;
}

static Complex_T divide(Complex_T x, Complex_T y)
{
    Complex_T quotient;
    float temp    = pow(y.real, 2) + pow(y.imag, 2);
    quotient.real = (x.real * y.real + x.imag * y.imag) / temp;
    quotient.imag = (x.imag * y.real - x.real * y.imag) / temp;
    return quotient;
}

static void ResetCalibration()
{
    Analyzer *const me = &Analyzer_inst;
    memset(me->current_offset_cal, 0, FREQ_POINTS_MAX * sizeof(me->current_offset_cal[0]));
    for (int i = 0; i < FREQ_POINTS_MAX; i++)
    {
        me->current_gain_cal[i].real = 1;
        me->current_gain_cal[i].imag = 0;
    }
}